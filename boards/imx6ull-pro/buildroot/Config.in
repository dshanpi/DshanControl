## boards/imx6ull-pro/buildroot/package/dshancontrol-imx6ull/Config.in
```kconfig
config BR2_PACKAGE_DSHANCONTROL_IMX6ULL
    bool "DshanControl i.MX6ULL Pro Lite component desktop"
    depends on BR2_PACKAGE_QT5BASE_WIDGETS
    depends on BR2_PACKAGE_PYTHON3
    select BR2_PACKAGE_PYTHON3_SQLITE
    select BR2_PACKAGE_PYTHON_FLASK
    select BR2_PACKAGE_SQLITE
    select BR2_PACKAGE_OPENSSL
    select BR2_PACKAGE_ZLIB
```

## boards/t113s4-sdnand/buildroot/Config.in
```kconfig
source "$BR2_EXTERNAL_DSHANCONTROL_PATH/package/dshancontrol-python/Config.in"
source "$BR2_EXTERNAL_DSHANCONTROL_PATH/package/dshancontrol/Config.in"

source "$BR2_EXTERNAL_DSHANCONTROL_PATH/package/wqy-zenhei/Config.in"
```

## boards/t113s4-sdnand/buildroot/package/dshancontrol-python/Config.in
```kconfig
config BR2_PACKAGE_DSHANCONTROL_PYTHON
	bool "DshanControl pinned Python runtime"
	depends on BR2_PACKAGE_PYTHON3
	help
	  Application runtime pinned for Python 3.7; installed privately without
	  changing Tina's legacy Flask or other applications' Python dependencies.
```

## boards/t113s4-sdnand/buildroot/package/dshancontrol/Config.in
```kconfig
config BR2_PACKAGE_DSHANCONTROL
	bool "DshanControl industrial desktop (S4 development)"
	depends on BR2_PACKAGE_QT5
	select BR2_PACKAGE_QT5BASE_GUI
	select BR2_PACKAGE_QT5BASE_WIDGETS
	select BR2_PACKAGE_QT5BASE_NETWORK
	select BR2_PACKAGE_QT5CHARTS
	select BR2_PACKAGE_QT5BASE_LINUXFB
	select BR2_PACKAGE_PYTHON3
	select BR2_PACKAGE_PYTHON3_SQLITE
	select BR2_PACKAGE_PYTHON3_SSL
	select BR2_PACKAGE_DSHANCONTROL_PYTHON
	select BR2_PACKAGE_BUSYBOX_INIT_BASE_FILES
	select BR2_PACKAGE_OPENSSL
	select BR2_PACKAGE_ZLIB
	select BR2_PACKAGE_CA_CERTIFICATES
	select BR2_PACKAGE_DEJAVU
	select BR2_PACKAGE_WQY_ZENHEI
	help
	  Existing DshanControl application with a separate S4 adapter.
	  Does not imply hardware or application updater qualification.

config BR2_PACKAGE_DSHANCONTROL_COMPONENT_DESKTOP
	bool "DshanControl component desktop services and image codecs"
	depends on BR2_PACKAGE_DSHANCONTROL
	depends on BR2_PACKAGE_TPLAYER
	select BR2_PACKAGE_LIBPNG
	select BR2_PACKAGE_JPEG
	help
	  Build the managed desktop provider, Cedar media worker and application-local
	  PNG/JPEG codecs for the pinned Qt 5.11.3 S4 runtime. Requires the audited
	  native permission/lifecycle policy; does not qualify an existing image.
```
