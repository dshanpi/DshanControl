## boards/imx6ull-pro/buildroot/Config.in
```kconfig
source "$BR2_EXTERNAL_DSHANCONTROL_IMX6ULL_PATH/package/dshancontrol-imx6ull/Config.in"
source "$BR2_EXTERNAL_DSHANCONTROL_IMX6ULL_PATH/package/soem/Config.in"
source "$BR2_EXTERNAL_DSHANCONTROL_IMX6ULL_PATH/package/omnigate-ethercat/Config.in"
```

## boards/imx6ull-pro/buildroot/package/dshancontrol-imx6ull/Config.in
```kconfig
config BR2_PACKAGE_DSHANCONTROL_IMX6ULL
	bool "DshanControl i.MX6ULL desktop"
	depends on BR2_arm && BR2_ARM_EABIHF
	depends on BR2_INSTALL_LIBSTDCPP
	depends on BR2_PACKAGE_QT5
	depends on BR2_PACKAGE_QT5BASE_WIDGETS
	depends on BR2_PACKAGE_QT5BASE_LINUXFB
	depends on BR2_PACKAGE_QT5BASE_FONTCONFIG
	select BR2_PACKAGE_DEJAVU
	select BR2_PACKAGE_OPENSSL
	select BR2_PACKAGE_ZLIB
	select BR2_PACKAGE_SQLITE
	select BR2_PACKAGE_CA_CERTIFICATES
	help
	  Native Qt Widgets desktop and separate desktop provider service.
	  Uses linuxfb/evdev and the BSP Qt codecs. No Allwinner Cedar backend.
	  The runtime CLI is included for development; OTA is not provisioned.
```

## boards/imx6ull-pro/buildroot/package/omnigate-ethercat/Config.in
```kconfig
config BR2_PACKAGE_OMNIGATE_ETHERCAT
	bool "DshanControl EtherCAT diagnostics"
	depends on BR2_TOOLCHAIN_HAS_THREADS
	select BR2_PACKAGE_SOEM
```
